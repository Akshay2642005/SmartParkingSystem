## firmware/esp32/main/Kconfig.projbuild
```kconfig
menu "Parking debug"
  config PARKING_DEBUG_INJECT
    bool "Enable distance injection over serial console (debug only)"
    default n
      help
        Adds a debug console task on UART0 that accepts
        setdist <slot-id> <cm>
        lines (e.g. "setdist 1 25") and feeds the value into the next scan
        of that slot as if the sensor had measured it. The injected value
        flows through the same validate -> filter -> debounce pipeline as a
        real measurement. Production builds leave this disabled (default n).
endmenu

menu "Parking MQTT"
  config PARKING_MQTT_ENABLE
    bool "Publish parking state over MQTT"
    default y

  config PARKING_MQTT_URI
    string "Broker URI"
    default "mqtt://localhost:1883"

  config PARKING_MQTT_USER
    string "Broker Username"
    default ""

  config PARKING_MQTT_PASSWORD
    string "Broker Password"
    default ""

  config PARKING_MQTT_SITE
    string "Site ID"
    default "main"

  config PARKING_MQTT_SECTION
    string "Section ID"
    default "A"

  config PARKING_WIFI_SSID
    string "WiFi SSID (station)"
    default "Wokwi-GUEST"
    help
      Network the node joins before opening the MQTT connection.
      Credentials live only in the local (untracked) sdkconfig.

  config PARKING_WIFI_PASSWORD
    string "WiFi password"
    default ""
    help
      Empty password configures an open network.
endmenu
```
